/* Copyright (c) 2013, The Linux Foundation. All rights reserved.
 *
 * This program is free software; you can redistribute it and/or modify
 * it under the terms of the GNU General Public License version 2 and
 * only version 2 as published by the Free Software Foundation.
 *
 * This program is distributed in the hope that it will be useful,
 * but WITHOUT ANY WARRANTY; without even the implied warranty of
 * MERCHANTABILITY or FITNESS FOR A PARTICULAR PURPOSE.  See the
 * GNU General Public License for more details.
 */

/*---------------------------------------------------------------------------
 * This file is autogenerated file using gcdb parser. Please do not edit it.
 * Update input XML file to add a new entry or update variable in this file
 * VERSION = "1.0"
 *---------------------------------------------------------------------------*/
&mdss_mdp {
	dsi_otm8018b_fwvga_vid: qcom,mdss_dsi_otm8018b_fwvga_video {
		qcom,mdss-dsi-panel-name = "OTM8018b fwvga video mode dsi panel";
		qcom,mdss-dsi-panel-controller = <&mdss_dsi0>;
		qcom,mdss-dsi-panel-type = "dsi_video_mode";
		qcom,mdss-dsi-panel-destination = "display_1";
		qcom,mdss-dsi-panel-framerate = <55>;
		qcom,mdss-dsi-virtual-channel-id = <0>;
		qcom,mdss-dsi-stream = <0>;
		qcom,mdss-dsi-panel-width = <480>;
		qcom,mdss-dsi-panel-height = <854>;
		qcom,mdss-dsi-h-front-porch = <70>;
		qcom,mdss-dsi-h-back-porch = <70>;
		qcom,mdss-dsi-h-pulse-width = <4>;
		qcom,mdss-dsi-h-sync-skew = <0>;
		qcom,mdss-dsi-v-back-porch = <16>;
		qcom,mdss-dsi-v-front-porch = <15>;
		qcom,mdss-dsi-v-pulse-width = <4>;
		qcom,mdss-dsi-h-left-border = <0>;
		qcom,mdss-dsi-h-right-border = <0>;
		qcom,mdss-dsi-v-top-border = <0>;
		qcom,mdss-dsi-v-bottom-border = <0>;
		qcom,mdss-dsi-bpp = <24>;
		qcom,mdss-dsi-color-order = <0>;
		qcom,mdss-dsi-underflow-color = <0xff>;
		qcom,mdss-dsi-border-color = <0>;
		qcom,mdss-dsi-on-command = [
			39 01 00 00 00 00 02
			00 00
			39 01 00 00 00 00 04
			FF 80 09 01
			39 01 00 00 00 00 02
			00 80
			39 01 00 00 00 00 03
			FF 80 09
			39 01 00 00 00 00 02
			00 03
			39 01 00 00 00 00 02
			FF 01
			39 01 00 00 00 00 02
			00 00
			39 01 00 00 00 00 03
			D8 87 87
			39 01 00 00 00 00 02
			00 B1
			39 01 00 00 00 00 02
			C5 A9
			39 01 00 00 00 00 02
			00 00
			39 01 00 00 00 00 02
			D9 03
			39 01 00 00 00 00 02
			00 90
			39 01 00 00 00 00 04
			C5 96 A7 01
			39 01 00 00 00 00 02
			00 81
			39 01 00 00 00 00 02
			C1 66
			39 01 00 00 00 00 02
			00 A1
			39 01 00 00 00 00 04
			C1 08 02 1B
			39 01 00 00 00 00 02
			00 81
			39 01 00 00 00 00 02
			C4 83
			39 01 00 00 00 00 02
			00 90
			39 01 00 00 00 00 02
			B3 02
			39 01 00 00 00 00 02
			00 92
			39 01 00 00 00 00 02
			B3 45
			39 01 00 00 00 00 02
			00 A7
			39 01 00 00 00 00 02
			B3 00
			39 01 00 00 00 00 02
			00 B4
			39 01 00 00 00 00 02
			C0 10
			39 01 00 00 00 00 02
			00 00
			39 01 00 00 00 00 02
			36 00
			39 01 00 00 00 00 02
			00 90
			39 01 00 00 00 00 07
			C0 00 44 00 00 00 03
			39 01 00 00 00 00 02
			00 A0
			39 01 00 00 00 00 02
			C1 EA
			39 01 00 00 00 00 02
			00 A6
			39 01 00 00 00 00 04
			C1 01 00 00
			39 01 00 00 00 00 02
			00 c6
			39 01 00 00 00 00 02
			b0 03
			39 01 00 00 00 00 02
			00 80
			39 01 00 00 00 00 07
			CE 87 03 00 86 03 00
			39 01 00 00 00 00 02
			00 90
			39 01 00 00 00 00 07
			CE 33 54 00 33 55 00
			39 01 00 00 00 00 02
			00 A0
			39 01 00 00 00 00 0F
			CE 38 03 03 58 00 00 00 38 02 03 59 00 00 00
			39 01 00 00 00 00 02
			00 B0
			39 01 00 00 00 00 0F
			CE 38 01 03 5A 00 00 00 38 00 03 5B 00 00 00
			39 01 00 00 00 00 02
			00 C0
			39 01 00 00 00 00 0F
			CE 30 00 03 5C 00 00 00 30 01 03 5D 00 00 00
			39 01 00 00 00 00 02
			00 D0
			39 01 00 00 00 00 0F
			CE 38 05 03 5E 00 00 00 38 04 03 5F 00 00 00
			39 01 00 00 00 00 02
			00 C0
			39 01 00 00 00 00 0B
			CF 00 00 00 00 00 00 01 80 00 09
			39 01 00 00 00 00 02
			00 C0
			39 01 00 00 00 00 10
			CB 00 04 04 04 04 00 00 04 04 04 04 00 00 00 00
			39 01 00 00 00 00 02
			00 D0
			39 01 00 00 00 00 10
			CB 00 00 00 00 00 00 04 04 04 04 00 00 04 04 04
			39 01 00 00 00 00 02
			00 E0
			39 01 00 00 00 00 0B
			CB 04 00 00 00 00 00 00 00 00 00
			39 01 00 00 00 00 02
			00 80
			39 01 00 00 00 00 0B
			CC 00 26 25 02 06 00 00 0A 0E 0C
			39 01 00 00 00 00 02
			00 90
			39 01 00 00 00 00 10
			CC 10 00 00 00 00 00 00 00 00 00 00 26 25 01 05
			39 01 00 00 00 00 02
			00 A0
			39 01 00 00 00 00 10
			CC 00 00 09 0D 0B 0F 00 00 00 00 00 00 00 00 00
			39 01 00 00 00 00 02
			00 B0
			39 01 00 00 00 00 0B
			CC 00 25 26 05 01 00 00 0D 09 0B
			39 01 00 00 00 00 02
			00 C0
			39 01 00 00 00 00 10
			CC 0F 00 00 00 00 00 00 00 00 00 00 25 26 06 02
			39 01 00 00 00 00 02
			00 D0
			39 01 00 00 00 00 10
			CC 00 00 0E 0A 0C 10 00 00 00 00 00 00 00 00 00
			39 01 00 00 00 00 02
			00 00
			39 01 00 00 00 00 11
			E1 05 07 09 0d 06 1a 0e 0e 00 04 03 08 0f 1f 1c 0B
			39 01 00 00 00 00 02
			00 00
			39 01 00 00 00 00 11
			E2 05 07 09 0d 06 1a 0e 0e 00 04 03 07 0F 20 1c 0B
			39 01 00 00 00 00 02
			00 00
			39 01 00 00 00 00 04
			FF FF FF FF
			05 01 00 00 78 00 02
			11 00
			05 01 00 00 32 00 02
			29 00
			];
		qcom,mdss-dsi-off-command = [05 01 00 00 32 00 02 28 00
					05 01 00 00 78 00 02 10 00];
		qcom,mdss-dsi-on-command-state = "dsi_lp_mode";
		qcom,mdss-dsi-off-command-state = "dsi_lp_mode";
		qcom,mdss-dsi-h-sync-pulse = <0>;
		qcom,mdss-dsi-traffic-mode = <2>;
		qcom,mdss-dsi-lane-map = <1>;
		qcom,mdss-dsi-bllp-eof-power-mode;
		qcom,mdss-dsi-bllp-power-mode;
		qcom,mdss-dsi-lane-0-state;
		qcom,mdss-dsi-lane-1-state;
		qcom,mdss-dsi-panel-timings = [8B 1F 14 00 45 4A 19 23 23 03 04 00];
		qcom,mdss-dsi-t-clk-post = <0x04>;
		qcom,mdss-dsi-t-clk-pre = <0x1b>;
		qcom,mdss-dsi-bl-min-level = <1>;
		qcom,mdss-dsi-bl-max-level = <31>;
		qcom,mdss-dsi-dma-trigger = <4>;
		qcom,mdss-dsi-mdp-trigger = <0>;
		qcom,mdss-dsi-bl-pmic-control-type = "bl_ctrl_gpio";
		qcom,mdss-dsi-reset-sequence = <1 20>, <0 2>, <1 20>;

	};
};
