/* Copyright (c) 2013, The Linux Foundation. All rights reserved.
 *
 * This program is free software; you can redistribute it and/or modify
 * it under the terms of the GNU General Public License version 2 and
 * only version 2 as published by the Free Software Foundation.
 *
 * This program is distributed in the hope that it will be useful,
 * but WITHOUT ANY WARRANTY; without even the implied warranty of
 * MERCHANTABILITY or FITNESS FOR A PARTICULAR PURPOSE.  See the
 * GNU General Public License for more details.
 */

/*---------------------------------------------------------------------------
 * This file is autogenerated file using gcdb parser. Please do not edit it.
 * Update input XML file to add a new entry or update variable in this file
 * VERSION = "1.0"
 *---------------------------------------------------------------------------*/
&mdss_mdp {
	dsi_fx_nt35510_wvga_cmd:qcom,mdss_dsi_fx_nt35510_wvga_cmd {
		qcom,mdss-dsi-panel-name = "feixun nt35510 wvga cmd mode dsi panel";
		qcom,mdss-dsi-panel-controller = <&mdss_dsi0>;
		qcom,mdss-dsi-panel-type = "dsi_cmd_mode";
		qcom,mdss-dsi-panel-destination = "display_1";
		qcom,mdss-dsi-panel-frame-rate = <60>;
		qcom,mdss-dsi-virtual-channel-id = <0>;
		qcom,mdss-dsi-stream = <0>;
		qcom,mdss-dsi-panel-width = <480>;
		qcom,mdss-dsi-panel-height = <800>;
		qcom,mdss-dsi-h-front-porch = <70>;
		qcom,mdss-dsi-h-back-porch = <70>;
		qcom,mdss-dsi-h-pulse-width = <10>;
		qcom,mdss-dsi-h-sync-skew = <0>;
		qcom,mdss-dsi-v-back-porch = <16>;
		qcom,mdss-dsi-v-front-porch = <20>;
		qcom,mdss-dsi-v-pulse-width = <4>;
		qcom,mdss-dsi-h-left-border = <0>;
		qcom,mdss-dsi-h-right-border = <0>;
		qcom,mdss-dsi-v-top-border = <0>;
		qcom,mdss-dsi-v-bottom-border = <0>;
		qcom,mdss-dsi-bpp = <24>;
		qcom,mdss-dsi-color-order = <0>;
		qcom,mdss-dsi-underflow-color = <0xff>;
		qcom,mdss-dsi-border-color = <0>;
		qcom,mdss-dsi-on-command = [
			39 01 00 00 00 00 06
			F0 55 AA 52 08 01
			39 01 00 00 00 00 04
			B0 0A 0A 0A
			39 01 00 00 00 00 04
			B6 34 34 34
			39 01 00 00 00 00 04
			B1 0A 0A 0A
			39 01 00 00 00 00 04
			B7 24 24 24
			39 01 00 00 00 00 04
			B2 00 00 00
			39 01 00 00 00 00 04
			B8 24 24 24
			39 01 00 00 00 00 02
			BF 01
			39 01 00 00 00 00 04
			B3 08 08 08
			39 01 00 00 00 00 04
			B9 34 34 34
			39 01 00 00 00 00 04
			BA 24 24 24
			39 01 00 00 00 00 04
			BC 00 AB 00
			39 01 00 00 00 00 04
			BD 00 AB 00
			39 01 00 00 00 00 03
			BE 00 7E
			39 01 00 00 00 00 35
			D1 00 00 00 01 00 3c 00 6F 00
			a1 00 e9 01 19 01 59 01 82 01
			bc 01 e6 02 1f 02 4B 02 4C 02
			72 02 98 02 ad 02 c6 02 d5 02
			e8 02 f5 03 06 03 14 03 29 03
			55 03 bb
			39 01 00 00 00 00 35
			D2 00 00 00 01 00 3c 00 6F 00
			a1 00 e9 01 19 01 59 01 82 01
			bc 01 e6 02 1f 02 4B 02 4C 02
			72 02 98 02 ad 02 c6 02 d5 02
			e8 02 f5 03 06 03 14 03 29 03
			55 03 bb
			39 01 00 00 00 00 35
			D3 00 00 00 01 00 3c 00 6F 00
			a1 00 e9 01 19 01 59 01 82 01
			bc 01 e6 02 1f 02 4B 02 4C 02
			72 02 98 02 ad 02 c6 02 d5 02
			e8 02 f5 03 06 03 14 03 29 03
			55 03 bb
			39 01 00 00 00 00 35
			D4 00 00 00 01 00 3c 00 6F 00
			a1 00 e9 01 19 01 59 01 82 01
			bc 01 e6 02 1f 02 4B 02 4C 02
			72 02 98 02 ad 02 c6 02 d5 02
			e8 02 f5 03 06 03 14 03 29 03
			55 03 bb
			39 01 00 00 00 00 35
			D5 00 00 00 01 00 3c 00 6F 00
			a1 00 e9 01 19 01 59 01 82 01
			bc 01 e6 02 1f 02 4B 02 4C 02
			72 02 98 02 ad 02 c6 02 d5 02
			e8 02 f5 03 06 03 14 03 29 03
			55 03 bb
			39 01 00 00 00 00 35
			D6 00 00 00 01 00 3c 00 6F 00
			a1 00 e9 01 19 01 59 01 82 01
			bc 01 e6 02 1f 02 4B 02 4C 02
			72 02 98 02 ad 02 c6 02 d5 02
			e8 02 f5 03 06 03 14 03 29 03
			55 03 bb
			39 01 00 00 00 00 06
			F0 55 AA 52 08 00
			39 01 00 00 00 00 03
			B1 FC 30
			39 01 00 00 00 00 02
			B6 06
			39 01 00 00 00 00 03
			B7 70 70
			39 01 00 00 00 00 05
			B8 01 05 05 05
			39 01 00 00 00 00 04
			BC 00 00 00
			39 01 00 00 00 00 06
			BD 01 90 1C 1C 00
			39 01 00 00 00 00 09
			CB 02 09 BC 02 00 80 10 0C
			39 01 00 00 00 00 02
			35 00
			39 01 00 00 00 00 02
			36 00
			05 01 00 00 96 00 02
			11 00
			05 01 00 00 78 00 02
			29 00];
		qcom,mdss-dsi-off-command = [05 01 00 00 32 00 02 28 00
			05 01 00 00 78 00 02 10 00];
		qcom,mdss-dsi-on-command-state = "dsi_lp_mode";
		qcom,mdss-dsi-off-command-state = "dsi_lp_mode";
		qcom,mdss-dsi-h-sync-pulse = <1>;
		qcom,mdss-dsi-traffic-mode = <2>;
		qcom,mdss-dsi-lane-map = <1>;
		qcom,mdss-dsi-bllp-eof-power-mode;
		qcom,mdss-dsi-bllp-power-mode;
		qcom,mdss-dsi-lane-0-state;
		qcom,mdss-dsi-lane-1-state;
		qcom,mdss-dsi-te-pin-select = <1>;
		qcom,mdss-dsi-te-v-sync-rd-ptr-irq-line = <0x2c>;
		qcom,mdss-dsi-te-v-sync-continues-lines = <0x3c>;
		qcom,mdss-dsi-te-dcs-command = <1>;
		qcom,mdss-dsi-te-check-enable;
		qcom,mdss-dsi-te-using-te-pin;
		qcom,mdss-dsi-panel-timings = [75 1A 11 00 3D 45 15 1D 1C 03 04 00];
		qcom,mdss-dsi-t-clk-post = <0x20>;
		qcom,mdss-dsi-t-clk-pre = <0x2f>;
		qcom,mdss-dsi-bl-min-level = <1>;
		qcom,mdss-dsi-bl-max-level = <31>;
		qcom,mdss-dsi-dma-trigger = <4>;
		qcom,mdss-dsi-mdp-trigger = <0>;
		qcom,mdss-dsi-bl-pmic-control-type = "bl_ctrl_gpio";
		qcom,mdss-dsi-reset-sequence = <1 20>, <0 2>, <1 20>;
	};
};
